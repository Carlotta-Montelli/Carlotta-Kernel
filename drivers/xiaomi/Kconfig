## drivers/xiaomi/Kconfig
```kconfig
menu "Xiaomi MIUI additions"

config XIAOMI_MIUI
	bool "Enable Xiaomi MIUI modifications"
	default y
	help
	  Enables compilation of Xiaomi MIUI specific vendor additions

	  Say Y if you want to compile the Xiaomi MIUI specific kernel modifications.
	  Say N if you want to discard the Xiaomi MIUI specific kernel modifications.

source "drivers/xiaomi/fragmention/Kconfig"

endmenu
```

## drivers/xiaomi/fragmention/Kconfig
```kconfig
config MI_FRAGMENTION
	bool "Xiaomi memory fragmention test"
	default y
	help
	  Say Y to enable MIUI Memory fragmentize simulate test
```
